## Week_2/bgm220p/Kconfig
```kconfig
# Copyright (c) 2024
# SPDX-License-Identifier: Apache-2.0

if BOARD_BGM220P

config BOARD
	string "BGM220P Module"
	help
	  This option selects the BGM220P development board.

config SOC_SERIES_EFR32BG22
	bool
	select SOC_FAMILY_SILABS
	select CPU_CORTEX_M33
	select SOC_GECKO_EMU_DCDC
	select SOC_GECKO_EMU_DCDC_MODE_ON

config SOC_PART_NUMBER_EFR32BG22C224F512IM40
	bool "EFR32BG22C224F512IM40"
	help
	  Part number for the BGM220P SoC

endif # BOARD_BGM220P
```

## Week_2/bgm220p/Kconfig.board
```kconfig
config BOARD_BGM220P
    bool "Silicon Labs BGM220P Module"
    select SOC_PART_NUMBER_EFR32BG22C224F512IM40
```

## Week_2/blinky_app/src/build/Kconfig/boards/Kconfig.defconfig
```kconfig
# Load Zephyr board defconfig descriptions.
osource "/workdir/zephyrproject/zephyr/boards/st/nucleo_f446re/Kconfig.defconfig"
```

## Week_2/blinky_app/src/build/Kconfig/boards/Kconfig.nucleo_f446re
```kconfig
# Load board Kconfig descriptions.
osource "/workdir/zephyrproject/zephyr/boards/st/nucleo_f446re/Kconfig.nucleo_f446re"
```

## Week_2/blinky_app/src/build/Kconfig/boards/Kconfig.sysbuild
```kconfig
# Load Sysbuild board Kconfig descriptions.
osource "/workdir/zephyrproject/zephyr/boards/st/nucleo_f446re/Kconfig.sysbuild"
```

## Week_2/blinky_app/src/build/Kconfig/soc/Kconfig
```kconfig
# Load Zephyr SoC Kconfig descriptions.
osource "/workdir/zephyrproject/zephyr/soc/xlnx/zynqmp/Kconfig"
osource "/workdir/zephyrproject/zephyr/soc/xlnx/zynq7000/Kconfig"
osource "/workdir/zephyrproject/zephyr/soc/xlnx/versalnet/Kconfig"
osource "/workdir/zephyrproject/zephyr/soc/xlnx/versal2/Kconfig"
osource "/workdir/zephyrproject/zephyr/soc/xen/Kconfig"
osource "/workdir/zephyrproject/zephyr/soc/wch/ch32v/Kconfig"
osource "/workdir/zephyrproject/zephyr/soc/ti/simplelink/Kconfig"
osource "/workdir/zephyrproject/zephyr/soc/ti/mspm0/Kconfig"
osource "/workdir/zephyrproject/zephyr/soc/ti/lm3s6965/Kconfig"
osource "/workdir/zephyrproject/zephyr/soc/ti/k3/Kconfig"
osource "/workdir/zephyrproject/zephyr/soc/telink/tlsr/Kconfig"
osource "/workdir/zephyrproject/zephyr/soc/starfive/jh71xx/Kconfig"
osource "/workdir/zephyrproject/zephyr/soc/st/stm32/Kconfig"
osource "/workdir/zephyrproject/zephyr/soc/snps/qemu_arc/Kconfig"
osource "/workdir/zephyrproject/zephyr/soc/snps/nsim/arc_v/Kconfig"
osource "/workdir/zephyrproject/zephyr/soc/snps/nsim/arc_classic/Kconfig"
osource "/workdir/zephyrproject/zephyr/soc/snps/hsdk4xd/Kconfig"
osource "/workdir/zephyrproject/zephyr/soc/snps/hsdk/Kconfig"
osource "/workdir/zephyrproject/zephyr/soc/snps/emsk/Kconfig"
osource "/workdir/zephyrproject/zephyr/soc/snps/emsdp/Kconfig"
osource "/workdir/zephyrproject/zephyr/soc/snps/arc_iot/Kconfig"
osource "/workdir/zephyrproject/zephyr/soc/silabs/Kconfig"
osource "/workdir/zephyrproject/zephyr/soc/sifive/sifive_freedom/Kconfig"
osource "/workdir/zephyrproject/zephyr/soc/sensry/Kconfig"
osource "/workdir/zephyrproject/zephyr/soc/rockchip/Kconfig"
osource "/workdir/zephyrproject/zephyr/soc/renode/riscv_virtual/Kconfig"
osource "/workdir/zephyrproject/zephyr/soc/renode/cortex_r8_virtual/Kconfig"
osource "/workdir/zephyrproject/zephyr/soc/renesas/smartbond/Kconfig"
osource "/workdir/zephyrproject/zephyr/soc/renesas/rz/Kconfig"
osource "/workdir/zephyrproject/zephyr/soc/renesas/rx/Kconfig"
osource "/workdir/zephyrproject/zephyr/soc/renesas/rcar/Kconfig"
osource "/workdir/zephyrproject/zephyr/soc/renesas/ra/Kconfig"
osource "/workdir/zephyrproject/zephyr/soc/realtek/ec/Kconfig"
osource "/workdir/zephyrproject/zephyr/soc/raspberrypi/rpi_pico/Kconfig"
osource "/workdir/zephyrproject/zephyr/soc/quicklogic/eos_s3/Kconfig"
osource "/workdir/zephyrproject/zephyr/soc/qemu/virt_riscv/Kconfig"
osource "/workdir/zephyrproject/zephyr/soc/qemu/malta/Kconfig"
osource "/workdir/zephyrproject/zephyr/soc/openisa/rv32m1/Kconfig"
osource "/workdir/zephyrproject/zephyr/soc/openhwgroup/cva6/Kconfig"
osource "/workdir/zephyrproject/zephyr/soc/oct/osd32mp15x/Kconfig"
osource "/workdir/zephyrproject/zephyr/soc/nxp/s32/Kconfig"
osource "/workdir/zephyrproject/zephyr/soc/nxp/rw/Kconfig"
osource "/workdir/zephyrproject/zephyr/soc/nxp/mcx/Kconfig"
osource "/workdir/zephyrproject/zephyr/soc/nxp/lpc/Kconfig"
osource "/workdir/zephyrproject/zephyr/soc/nxp/layerscape/Kconfig"
osource "/workdir/zephyrproject/zephyr/soc/nxp/kinetis/Kconfig"
osource "/workdir/zephyrproject/zephyr/soc/nxp/imxrt/Kconfig"
osource "/workdir/zephyrproject/zephyr/soc/nxp/imx/Kconfig"
osource "/workdir/zephyrproject/zephyr/soc/nuvoton/numicro/Kconfig"
osource "/workdir/zephyrproject/zephyr/soc/nuvoton/numaker/Kconfig"
osource "/workdir/zephyrproject/zephyr/soc/nuvoton/npcx/Kconfig"
osource "/workdir/zephyrproject/zephyr/soc/nuvoton/npcm/Kconfig"
osource "/workdir/zephyrproject/zephyr/soc/nordic/Kconfig"
osource "/workdir/zephyrproject/zephyr/soc/neorv32/Kconfig"
osource "/workdir/zephyrproject/zephyr/soc/native/inf_clock/Kconfig"
osource "/workdir/zephyrproject/zephyr/soc/microchip/sam/Kconfig"
osource "/workdir/zephyrproject/zephyr/soc/microchip/miv/Kconfig"
osource "/workdir/zephyrproject/zephyr/soc/microchip/mec/Kconfig"
osource "/workdir/zephyrproject/zephyr/soc/mediatek/mt8xxx/Kconfig"
osource "/workdir/zephyrproject/zephyr/soc/lowrisc/opentitan/Kconfig"
osource "/workdir/zephyrproject/zephyr/soc/litex/litex_vexriscv/Kconfig"
osource "/workdir/zephyrproject/zephyr/soc/ite/ec/Kconfig"
osource "/workdir/zephyrproject/zephyr/soc/intel/raptor_lake/Kconfig"
osource "/workdir/zephyrproject/zephyr/soc/intel/lakemont/Kconfig"
osource "/workdir/zephyrproject/zephyr/soc/intel/intel_socfpga_std/Kconfig"
osource "/workdir/zephyrproject/zephyr/soc/intel/intel_socfpga/Kconfig"
osource "/workdir/zephyrproject/zephyr/soc/intel/intel_niosv/Kconfig"
osource "/workdir/zephyrproject/zephyr/soc/intel/intel_ish/Kconfig"
osource "/workdir/zephyrproject/zephyr/soc/intel/intel_adsp/Kconfig"
osource "/workdir/zephyrproject/zephyr/soc/intel/elkhart_lake/Kconfig"
osource "/workdir/zephyrproject/zephyr/soc/intel/atom/Kconfig"
osource "/workdir/zephyrproject/zephyr/soc/intel/apollo_lake/Kconfig"
osource "/workdir/zephyrproject/zephyr/soc/intel/alder_lake/Kconfig"
osource "/workdir/zephyrproject/zephyr/soc/infineon/cat3/Kconfig"
osource "/workdir/zephyrproject/zephyr/soc/infineon/cat1c/Kconfig"
osource "/workdir/zephyrproject/zephyr/soc/infineon/cat1b/Kconfig"
osource "/workdir/zephyrproject/zephyr/soc/infineon/cat1a/Kconfig"
osource "/workdir/zephyrproject/zephyr/soc/gd/gd32/Kconfig"
osource "/workdir/zephyrproject/zephyr/soc/gaisler/leon3/Kconfig"
osource "/workdir/zephyrproject/zephyr/soc/gaisler/gr716a/Kconfig"
osource "/workdir/zephyrproject/zephyr/soc/espressif/Kconfig"
osource "/workdir/zephyrproject/zephyr/soc/ene/kb1200/Kconfig"
osource "/workdir/zephyrproject/zephyr/soc/ene/kb106x/Kconfig"
osource "/workdir/zephyrproject/zephyr/soc/efinix/sapphire/Kconfig"
osource "/workdir/zephyrproject/zephyr/soc/cdns/xtensa_sample_controller/Kconfig"
osource "/workdir/zephyrproject/zephyr/soc/cdns/sample_controller32/Kconfig"
osource "/workdir/zephyrproject/zephyr/soc/cdns/dc233c/Kconfig"
osource "/workdir/zephyrproject/zephyr/soc/brcm/bcmvk/Kconfig"
osource "/workdir/zephyrproject/zephyr/soc/brcm/bcm2712/Kconfig"
osource "/workdir/zephyrproject/zephyr/soc/brcm/bcm2711/Kconfig"
osource "/workdir/zephyrproject/zephyr/soc/bflb/Kconfig"
osource "/workdir/zephyrproject/zephyr/soc/atmel/sam0/Kconfig"
osource "/workdir/zephyrproject/zephyr/soc/atmel/sam/Kconfig"
osource "/workdir/zephyrproject/zephyr/soc/aspeed/Kconfig"
osource "/workdir/zephyrproject/zephyr/soc/arm/Kconfig"
osource "/workdir/zephyrproject/zephyr/soc/arm/beetle/Kconfig"
osource "/workdir/zephyrproject/zephyr/soc/antmicro/myra/Kconfig"
osource "/workdir/zephyrproject/zephyr/soc/andestech/Kconfig"
osource "/workdir/zephyrproject/zephyr/soc/amd/acp_6_0/Kconfig"
osource "/workdir/zephyrproject/zephyr/soc/ambiq/Kconfig"
osource "/workdir/zephyrproject/zephyr/soc/aesc/Kconfig"
osource "/workdir/zephyrproject/zephyr/soc/adi/max32/Kconfig"
```

## Week_2/config_files/Kconfig.defconfig
```kconfig
# Copyright (c) 2025 Hariharan Sivakumar
# SPDX-License-Identifier: Apache-2.0

if SOC_SERIES_BGM220P

config NUM_IRQS
	# must be >= the highest interrupt number used
	default 60

config PM
	select UART_INTERRUPT_DRIVEN

config GPIO_GECKO
	default y

endif
```

## Week_2/config_files/Kconfig.soc
```kconfig
# Copyright (c) 2025 Your Name
# SPDX-License-Identifier: Apache-2.0

config SOC_SERIES_BGM220P
    bool
    select SOC_FAMILY_SILABS_BGM
    help
      Silicon Labs BGM220P Series MCU

config SOC_PART_NUMBER_BGM220PC22HNA
    bool
    select SOC_SERIES_BGM220P

config SOC_SERIES
    default "bgm220p" if SOC_SERIES_BGM220P

config SOC
    default "bgm220pc22hna" if SOC_PART_NUMBER_BGM220PC22HNA

config SOC_PART_NUMBER
    default "BGM220PC22HNA" if SOC_PART_NUMBER_BGM220PC22HNA
```
