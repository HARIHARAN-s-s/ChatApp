/dts-v1/;

#include <zephyr/dt-bindings/gpio/gpio.h>
#include <arm/silabs/bgm220p.dtsi>   /* <-- this should come before / { } */
//#include <arm/silabs/efr32bg22.dtsi>


&{/} {
	model = "Silicon Labs BGM220P Module";
	compatible = "silabs,bgm220p", "silabs,efr32bg22";

	chosen {
		zephyr,console = &usart1;
		zephyr,shell-uart = &usart1;
		zephyr,uart-pipe = &usart1;
		zephyr,flash = &flash0;
		zephyr,sram = &sram0;
	};

	leds {
		compatible = "gpio-leds";

		led0: led_0 {
			gpios = <&gpioa 4 GPIO_ACTIVE_HIGH>;
			label = "LED 0";
		};
	};
};

